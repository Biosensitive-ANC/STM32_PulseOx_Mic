#include "oled.h"

// Reference to the global I2C handle (needs to be defined and initialized in main.c)
extern I2C_HandleTypeDef hi2c1;

/**
 * @brief Send a command or data to the OLED
 * @param mode OLED_CMD indicates command mode, OLED_DATA indicates data mode
 * @param data The byte to be sent
 */
void OLED_Write(uint8_t mode, uint8_t data) {
    uint8_t buffer[2];
    buffer[0] = mode;  // Control byte
    buffer[1] = data;  // Data
    HAL_I2C_Master_Transmit(&hi2c1, OLED_ADDRESS, buffer, 2, HAL_MAX_DELAY);
}

/**
 * @brief Initialize the OLED
 */
void OLED_Init(void) {
    HAL_Delay(100); // Wait for the screen to power up and stabilize

    // Initialization commands (based on the SSD1306 datasheet)
    OLED_Write(OLED_CMD, 0xAE); // Turn off display
    OLED_Write(OLED_CMD, 0x20); // Set memory addressing mode
    OLED_Write(OLED_CMD, 0x10); // Use horizontal addressing mode
    OLED_Write(OLED_CMD, 0xB0); // Set page start address
    OLED_Write(OLED_CMD, 0xC8); // Set COM output scan direction (from top to bottom)
    OLED_Write(OLED_CMD, 0x00); // Set lower column address
    OLED_Write(OLED_CMD, 0x10); // Set higher column address
    OLED_Write(OLED_CMD, 0x40); // Set display start line
    OLED_Write(OLED_CMD, 0x81); // Set contrast control
    OLED_Write(OLED_CMD, 0xFF); // Maximum contrast
    OLED_Write(OLED_CMD, 0xA1); // Set segment re-map (left to right)
    OLED_Write(OLED_CMD, 0xA6); // Set normal display mode
    OLED_Write(OLED_CMD, 0xA8); // Set multiplex ratio
    OLED_Write(OLED_CMD, 0x3F); // 1/64 duty cycle
    OLED_Write(OLED_CMD, 0xD3); // Set display offset
    OLED_Write(OLED_CMD, 0x00); // No offset
    OLED_Write(OLED_CMD, 0xD5); // Set display clock divide ratio
    OLED_Write(OLED_CMD, 0xF0); // Set to default value
    OLED_Write(OLED_CMD, 0xD9); // Set pre-charge period
    OLED_Write(OLED_CMD, 0x22); //
    OLED_Write(OLED_CMD, 0xDA); // Set COM hardware configuration
    OLED_Write(OLED_CMD, 0x12); //
    OLED_Write(OLED_CMD, 0xDB); // Set VCOMH deselect level
    OLED_Write(OLED_CMD, 0x20); // ~0.77×VCC
    OLED_Write(OLED_CMD, 0x8D); // Set charge pump
    OLED_Write(OLED_CMD, 0x14); // Enable charge pump
    OLED_Write(OLED_CMD, 0xAF); // Turn on display
}

/**
 * @brief Clear the OLED display
 */
void OLED_Clear(void) {
    for (uint8_t page = 0; page < 8; page++) {
        OLED_Write(OLED_CMD, 0xB0 + page); // Set page address
        OLED_Write(OLED_CMD, 0x00);        // Set lower column address
        OLED_Write(OLED_CMD, 0x10);        // Set higher column address
        for (uint8_t col = 0; col < 128; col++) {
            OLED_Write(OLED_DATA, 0x00); // Clear display
        }
    }
}

/**
 * @brief Turn on all pixels on the OLED
 */
void OLED_Fill(void) {
    for (uint8_t page = 0; page < 8; page++) {
        OLED_Write(OLED_CMD, 0xB0 + page); // Set page address
        OLED_Write(OLED_CMD, 0x00);        // Set lower column address
        OLED_Write(OLED_CMD, 0x10);        // Set higher column address
        for (uint8_t col = 0; col < 128; col++) {
            OLED_Write(OLED_DATA, 0xFF); // Fill with data, turning on all 8 pixels in each column
        }
    }
}

/**
 * @brief Display a character at a specified position
 * @param x X-coordinate (column address, 0~127)
 * @param y Page address (row number, 0~7)
 * @param ch Character to display
 */
void OLED_ShowChar(uint8_t x, uint8_t y, char ch) {
    if (ch < 32 || ch > 127) return; // Character out of range

    OLED_Write(OLED_CMD, 0xB0 + y);         // Set page address
    OLED_Write(OLED_CMD, 0x00 + (x & 0x0F)); // Set lower column address
    OLED_Write(OLED_CMD, 0x10 + ((x >> 4) & 0x0F)); // Set higher column address

    const uint8_t *font_data = Font8x8[ch - 32]; // Get character dot matrix data

    for (int i = 0; i < 8; i++) {
        OLED_Write(OLED_DATA, font_data[i]); // Write character dot matrix data
    }
}

/**
 * @brief Display a string at a specified position
 * @param x Starting X-coordinate (column address)
 * @param y Starting page address (row number)
 * @param str String to display
 */
void OLED_ShowString(uint8_t x, uint8_t y, char* str) {
    while (*str) {
        OLED_ShowChar(x, y, *str); // Display individual character
        x += 8;                    // Each character occupies 8 columns
        if (x > 120) {             // Wrap to the next line if exceeding screen width
            x = 0;
            y++;
        }
        str++;
    }
}

// Character dot matrix font table (ASCII 32-127, 8x8 font)
const uint8_t Font8x8[96][8] = {
    // ASCII 32 ~ 127 (space ~ ~)
    {0x00, 0x00, 0x00, 0x00, 0x00, 0x00, 0x00, 0x00}, // 空格
    {0x00, 0x00, 0x5F, 0x00, 0x00, 0x00, 0x00, 0x00}, // !
    {0x00, 0x07, 0x00, 0x07, 0x00, 0x00, 0x00, 0x00}, // "
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    {0x08, 0x04, 0x08, 0x10, 0x08, 0x00, 0x00, 0x00}, // ~
};

